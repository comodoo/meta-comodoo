## meta-comodoo/conf/layer.conf
```bitbake
# We have a conf and classes directory, add to BBPATH
BBPATH .= ":${LAYERDIR}"

# We have recipes-* directories, add to BBFILES
BBFILES += "${LAYERDIR}/recipes-*/*/*.bb \
	${LAYERDIR}/recipes-*/*/*.bbappend"

BBFILE_COLLECTIONS += "comodoo"
BBFILE_PATTERN_comodoo = "^${LAYERDIR}/"
BBFILE_PRIORITY_comodoo = "6"
```

## meta-rpi-eleduino-7inch-1024x600/conf/layer.conf
```bitbake
# We have a conf and classes directory, add to BBPATH
BBPATH .= ":${LAYERDIR}"

# We have recipes-* directories, add to BBFILES
BBFILES += "${LAYERDIR}/recipes-*/*/*.bb \
	${LAYERDIR}/recipes-*/*/*.bbappend"

BBFILE_COLLECTIONS += "rpi-eleduino-7inch-1024x600"
BBFILE_PATTERN_rpi-eleduino-7inch-1024x600 = "^${LAYERDIR}/"
BBFILE_PRIORITY_rpi-eleduino-7inch-1024x600 = "6"
```

## meta-rpi-fixed-fb/conf/layer.conf
```bitbake
# We have a conf and classes directory, add to BBPATH
BBPATH .= ":${LAYERDIR}"

# We have recipes-* directories, add to BBFILES
BBFILES += "${LAYERDIR}/recipes-*/*/*.bb \
	${LAYERDIR}/recipes-*/*/*.bbappend"

BBFILE_COLLECTIONS += "rpi-fixed-fb"
BBFILE_PATTERN_rpi-fixed-fb = "^${LAYERDIR}/"
BBFILE_PRIORITY_rpi-fixed-fb = "6"
```
